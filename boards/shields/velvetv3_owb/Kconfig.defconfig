## boards/shields/velvetv3_owb/Kconfig.defconfig
```kconfig
if SHIELD_VELVETV3_OWB_LEFT || SHIELD_VELVETV3_OWB_PH_LEFT || SHIELD_VELVETV3_OWB_RIGHT

config ZMK_SPLIT
    default y

endif

if SHIELD_VELVETV3_OWB_LEFT

config ZMK_KEYBOARD_NAME
    default "VelvetV3 OWB"

config ZMK_SPLIT_ROLE_CENTRAL
    default y

config ZMK_SPLIT_BLE_CENTRAL_BATTERY_LEVEL_FETCHING
    default y

config ZMK_SPLIT_BLE_CENTRAL_BATTERY_LEVEL_PROXY
    default y

endif
```

## boards/shields/velvetv3_owb/Kconfig.shield
```kconfig
config SHIELD_VELVETV3_OWB_LEFT
    def_bool $(shields_list_contains,velvetv3_owb_left)

config SHIELD_VELVETV3_OWB_PH_LEFT
    def_bool $(shields_list_contains,velvetv3_owb_ph_left)

config SHIELD_VELVETV3_OWB_RIGHT
    def_bool $(shields_list_contains,velvetv3_owb_right)
```

## boards/shields/velvetv3_owb_dongle_adapter/Kconfig.defconfig
```kconfig
if SHIELD_VELVETV3_OWB_DONGLE_ADAPTER

config ZMK_KEYBOARD_NAME
    default "VelvetV3 OWB"

config ZMK_SPLIT
    default y

config ZMK_SPLIT_ROLE_CENTRAL
    default y

config ZMK_SPLIT_BLE_CENTRAL_PERIPHERALS
    default 2

config ZMK_SPLIT_BLE_CENTRAL_BATTERY_LEVEL_FETCHING
    default y

config ZMK_SPLIT_BLE_CENTRAL_BATTERY_LEVEL_PROXY
    default y

endif
```

## boards/shields/velvetv3_owb_dongle_adapter/Kconfig.shield
```kconfig
config SHIELD_VELVETV3_OWB_DONGLE_ADAPTER
    def_bool $(shields_list_contains,velvetv3_owb_dongle_adapter)
```

## boards/shields/velvetv3_owb_neoncat_display/Kconfig.shield
```kconfig
config SHIELD_VELVETV3_OWB_NEONCAT_DISPLAY
    def_bool $(shields_list_contains,velvetv3_owb_neoncat_display)
```

## config/west.yml
```yaml
manifest:
  projects:
    - name: zmk
      url: https://github.com/cormoran/zmk
      revision: e5c9b6915b56801193e359dd9bad4a167ce0d1b8
      import: app/west.yml
    - name: zmk-dongle-screen-engine
      url: https://github.com/hitsmaxft/zmk-dongle-screen-engine
      revision: 2a92158b4d421600dd07114a131cfdc3c512d3f1
    - name: zdse-themes
      url: https://github.com/hitsmaxft/zdse-themes
      revision: dae4019bae2977896eb840a29b80f66afbc2a899
    - name: zmk-module-ble-management
      url: https://github.com/cormoran/zmk-module-ble-management
      revision: 57738cc4fc6ba80e82a7ac57741a0339cb186cd4
    - name: zmk-module-battery-history
      url: https://github.com/cormoran/zmk-module-battery-history
      revision: 307755dd2ad4d320e14de162e8e5ef018f29d929
    - name: zmk-module-settings-rpc
      url: https://github.com/cormoran/zmk-module-settings-rpc
      revision: 78f86df9e6c5edaf57bef3ccbd7f360cfdf49291
    - name: zmk-module-runtime-input-processor
      url: https://github.com/cormoran/zmk-module-runtime-input-processor
      revision: 43618985f8c9d5457cc333b7ca0733f2d361911e
    - name: zmk-feature-runtime-macro
      url: https://github.com/cormoran/zmk-feature-runtime-macro
      revision: 38530962eb7061b60efcb98e84585cfb1f0cb6de
    - name: zmk-feature-custom-settings
      url: https://github.com/cormoran/zmk-feature-custom-settings
      revision: c6a7fef3a3be3d3ace5de9a4b0628c6418cd1f3f
  self:
    path: config
```
